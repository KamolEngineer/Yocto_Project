## meta-rpi4-bsp/conf/machine/rpi4.conf
```bitbake
#@TYPE: Machine
#@NAME: RPI4 machine
#@DESCRIPTION: Reference machine configuration for RPI4 boards

MACHINE_EXTRA_RRECOMMENDS = "kernel-modules"

DEFAULTTUNE ?= "cortexa72"
include conf/machine/include/arm/armv8a/tune-cortexa72.inc

IMAGE_FSTYPES += " wic.bz2 wic.bmap"
WKS_FILE ?= "rpi4.wks"
do_image_wic[depends] += "virtual/kernel:do_deploy bootfiles:do_deploy"

SERIAL_CONSOLES ?= "115200;ttyS0"


PREFERRED_PROVIDER_virtual/kernel ?= "linux-raspberrypi"
PREFERRED_VERSION_linux-yocto ?= "6.6%"

KERNEL_IMAGETYPE = "Image"
SDIMG_KERNELIMAGE = "kernel8.img"

MACHINE_FEATURES = "usbgadget usbhost vfat alsa"

#IMAGE_BOOT_FILES ?= "u-boot.${UBOOT_SUFFIX} ${SPL_BINARY} ${KERNEL_IMAGETYPE} ${DTB_FILES}"

BOOTFILES_DIR_NAME ?= "bootfiles"

IMAGE_BOOT_FILES ?= "${BOOTFILES_DIR_NAME}/* ${KERNEL_IMAGETYPE};${SDIMG_KERNELIMAGE}"
```
